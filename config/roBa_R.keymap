#include "roBa_L.keymap"

&trackball {
    scroll-layers = <L_ALT_SCROLL L_COMMAND_SCROLL>;
    snipe-layers = <L_ALT_CURSORSNIPE L_COMMAND_CURSORSNIPE>;

    arrows {
        layers = <L_LEFTARROW_ENABLETRACKBALL L_RIGHTARROW_ENABLETRACKBALL>;
        bindings =
            <&kp RIGHT_ARROW>,
            <&kp LEFT_ARROW>,
            <&kp UP_ARROW>,
            <&kp DOWN_ARROW>;

        tick = <10>;
        wait-ms = <5>;
        tap-ms = <5>;
    };

    volume {
        layers = <L_VOLUME>;
        bindings =
                <&none>,
                <&none>,
                <&kp C_VOLUME_UP>,
                <&kp C_VOLUME_DOWN>;

        wait-ms = <5>;
        tap-ms = <5>;
    };
};