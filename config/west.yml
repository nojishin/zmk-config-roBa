## config/west.yml
```yaml
manifest:
  remotes:
    - name: zmkfirmware
      url-base: https://github.com/zmkfirmware
    - name: nojishin
      url-base: https://github.com/nojishin
  projects:
    - name: zmk
      remote: zmkfirmware
      revision: main
      import: app/west.yml
    - name: zmk-pmw3610-driver-improve-scroll
      remote: nojishin
      revision: scroll-acceleration-feature 
  self:
    path: config
```
